## app/boards/shields/breadboard/Kconfig.defconfig
```kconfig
# Copyright (c) 2020 The ZMK Contributors
# SPDX-License-Identifier: MIT

if SHIELD_BREADBOARD_LEFT

config ZMK_KEYBOARD_NAME
    default "arcizzu"

endif

if SHIELD_BREADBOARD_RIGHT

config ZMK_KEYBOARD_NAME
    default "arcizzu"

endif


if SHIELD_BREADBOARD_LEFT

    config ZMK_SPLIT_BLE_ROLE_CENTRAL
        default y

endif

if SHIELD_BREADBOARD_LEFT || SHIELD_BREADBOARD_RIGHT
    CONFIG_ZMK_SPLIT=y
endif
```

## app/boards/shields/nrf52840express/Kconfig.shield
```kconfig
# Copyright (c) 2021 The ZMK Contributors
# SPDX-License-Identifier: MIT

config SHIELD_NRF52840EXPRESS
    def_bool $(shields_list_contains,nrf52840express)
```
